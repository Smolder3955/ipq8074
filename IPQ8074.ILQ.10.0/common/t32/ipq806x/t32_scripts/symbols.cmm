;
; Copyright (c) 2017 Qualcomm Technologies, Inc.
; All Rights Reserved.
; Confidential and Proprietary - Qualcomm Technologies, Inc.
;


;********************************************************************
; 		symbols.cmm					   **
;********************************************************************

local &force

entry &force

if ("&force"!="")
   goto LOAD_SYMBOL

if (Y.EXIST(AKRONITE))
(
    enddo
)

LOAD_SYMBOL:

print " Loading register symbols ..."

Y.CREATE.L   AKRONITE	0x00000014  ;dummy

do symbols_VI.cmm

print " Done Loading register symbols."

ENDDO
