//============================================================================
//  Name:                                                                     
//    std_extensions.cmm 
//
//  Description:                                                              
//    None 
//                                                                            
// Copyright (c) 2019 by QUALCOMM, Incorporated.  All Rights Reserved.        
//============================================================================
//                                                                            
// *** AUTO GENERATED FILE - DO NOT EDIT                                      
//                                                                            
// GENERATED: Fri May 31 08:11:19 2019 
//============================================================================

ENDDO