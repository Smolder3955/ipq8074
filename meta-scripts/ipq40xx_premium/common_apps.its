## qsdk/qca/feeds/hyfi/qca-hyfi-networking/qca-hyd/Config.in
```kconfig
choice
    prompt "Ethernet Speed"
    default HYD_GIGABIT_ETHERNET
    help
        set Ethernet speed

config HYD_GIGABIT_ETHERNET
    bool "Gigabit Ethernet"
    help
        use gigabit ethernet

config HYD_FAST_ETHERNET
    bool "Fast Ethernet"
    help
        use fast ethernet

endchoice

config HYD_WIFI_LOAD_BALANCING
	bool "Enable Wi-Fi Load Balancing Feature"
	default y
	help
	  This enables Wi-Fi load balancing (aka. steering) in hyd

config HYD_SUPPORT_VHT160
	bool "Support VHT 160 MHz"
	depends on PACKAGE_kmod-qca-wifi-akronite-perf||PACKAGE_kmod-qca-wifi-dakota-perf||PACKAGE_kmod-qca-wifi-perf||PACKAGE_kmod-qca-wifi-unified-perf||PACKAGE_kmod-qca-wifi-unified-profile||PACKAGE_kmod-qca-wifi-lowmem-profile

	default y
	help
	  This enables the HYD support for 160 MHz

config HYD_SUPPORT_CFG80211
	bool "Flag cfg80211 based config layer for HYD"
	depends on PACKAGE_qca-cfg80211
	default y
	help
	  CFG80211 support for HYD

config HYD_SUPPORT_SONLIB
	bool "Enable SON Library support for HYD"
	default y
	help
	  SON Library support for HYD
```

## qsdk/qca/src/u-boot-2016/board/ipq6018/Kconfig
```kconfig
if ARCH_IPQ6018

config SYS_CPU
       default "ipq6018"

config SYS_BOARD
       default "ipq6018"

config SYS_VENDOR
       default "qca/arm"

config SYS_CONFIG_NAME
       default "ipq6018"

endif
```
