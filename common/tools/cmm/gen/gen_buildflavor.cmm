ENTRY &ARG0


IF ("&ARG0"=="None")
(
	&PRODUCT_FLAVOR="None"
)
ENDDO