;
; Copyright (c) 2017 Qualcomm Technologies, Inc.
; All Rights Reserved.
; Confidential and Proprietary - Qualcomm Technologies, Inc.
;

;********************************************************************
; 		t32_config_rpm.cmm				   **
;********************************************************************

setup.bakfile off

enddo
