/*
 * Copyright (c) 2019, The Linux Foundation. All rights reserved.
 *
 * This program is free software; you can redistribute it and/or modify
 * it under the terms of the GNU General Public License version 2 and
 * only version 2 as published by the Free Software Foundation.
 *
 * This program is distributed in the hope that it will be useful,
 * but WITHOUT ANY WARRANTY; without even the implied warranty of
 * MERCHANTABILITY or FITNESS FOR A PARTICULAR PURPOSE.  See the
 * GNU General Public License for more details.
 */

/dts-v1/;
#include "ipq6018-soc.dtsi"
/ {
	model ="QCA, IPQ6018-CP03-C1";
	compatible = "qca,ipq6018", "qca,ipq6018-cp03-c1";
	machid = <0x8030200>;
	config_name = "config@cp03-c1";

	aliases {
		console = "/serial@78B1000";
		usb0 = "/xhci@8a00000";
	};
};

