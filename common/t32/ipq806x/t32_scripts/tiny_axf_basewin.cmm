;
; Copyright (c) 2017 Qualcomm Technologies, Inc.
; All Rights Reserved.
; Confidential and Proprietary - Qualcomm Technologies, Inc.
;

;********************************************************************
; 		tiny_axf_basewin.cmm				   **
;********************************************************************
 B::

 TOOLBAR ON
 STATUSBAR ON
 FRAMEPOS 9.4286,6.6923,,,Maximized
 WINPAGE.RESET

 WINCLEAR
 WINPOS 120.71 37.692 56. 19. 0. 0. W002
 Var.Local

 WINPOS 0.0 40.154 116. 17. 0. 0. W0002
 term.gate

 WINPOS 0.0 0.0 117. 36. 13. 1. W000
 WINTABS 16. 18. 25. 62.
 data.list

 WINPAGE.SELECT P000

 ENDDO
