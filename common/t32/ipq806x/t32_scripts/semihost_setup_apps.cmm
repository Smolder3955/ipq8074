;
; Copyright (c) 2017 Qualcomm Technologies, Inc.
; All Rights Reserved.
; Confidential and Proprietary - Qualcomm Technologies, Inc.
;

;****************************************************************
;	semihost_setup_apps.cmm				       **
;****************************************************************

tronchip.set swi on
term.heapinfo 0x30000 0x38000 0x3FB00 0x38000
term.method armswi
term.scroll on
term.mode string
term.size 80. 1000.

enddo
