;
; Copyright (c) 2017 Qualcomm Technologies, Inc.
; All Rights Reserved.
; Confidential and Proprietary - Qualcomm Technologies, Inc.
;
do ..\t32_scripts\load_code_RPM_db.cmm
d.s 0xa40020++7 %le %long 0x4000
